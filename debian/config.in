## debian/config.in
```kconfig
#include "variables"
#! /bin/bash -e
#
# <% config %> script for <:=${PACKAGE}:>
#
<:=@COPYRIGHT:>//

set -o posix

source <:=${CONFMODULE}:>
db_version 2.0

case "${1}" in
    configure|reconfigure)
	db_input medium <:=$PACKAGE:>/default || true
	db_go || true;;
    *) echo >&2 "${0##*/}/<:=${PACKAGE}:>:" \
	"Unknown argument: \"${1}\"."
	exit 1
esac

exit 0
<:
# arch-tag: 0c222277-b851-436c-912e-b5c8e4468867
#
# local variables:
# mode: shell-script
# coding: utf-8
# ispell-local-dictionary: "american"
# ispell-check-comments: exclusive
# end:
:>//
```
